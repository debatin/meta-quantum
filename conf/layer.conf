## conf/layer.conf
```bitbake
# We have a conf and classes directory, add to BBPATH
BBPATH .= ":${LAYERDIR}"

# We have recipes-* directories, add to BBFILES
BBFILES += "${LAYERDIR}/recipes-*/*/*.bb \
            ${LAYERDIR}/recipes-*/*/*.bbappend"

BBFILE_COLLECTIONS += "meta-quantum"
BBFILE_PATTERN_meta-quantum = "^${LAYERDIR}/"
BBFILE_PRIORITY_meta-quantum = "6"

LAYERDEPENDS_meta-quantum = "core"
LAYERSERIES_COMPAT_meta-quantum = "dunfell"
```
